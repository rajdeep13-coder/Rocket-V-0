#include <Adafruit_MPU6050.h>
#include <Adafruit_Sensor.h>
#include <Wire.h>
#include <ESP32Servo.h>
#include <Adafruit_GFX.h>
#include <Adafruit_SSD1306.h>

#if __has_include("sim_config.h")
#include "sim_config.h"
#else
#define SIMULATION_MODE 0
#endif

#define OLED_RESET 4
Adafruit_SSD1306 display(128, 64, &Wire, OLED_RESET);

const unsigned char myBitmap [] PROGMEM = {
  0x00, 0x00, 0x00, 0x00, 0x00, 0x00, 0x00, 0x00, 0x00, 0x00, 0x00, 0x00, 0x00, 0x00, 0x00, 0x00, 
  0x00, 0x00, 0x00, 0x00, 0x00, 0x00, 0x00, 0x00, 0x00, 0x00, 0x00, 0x00, 0x00, 0x00, 0x00, 0x00, 
  0x00, 0x00, 0x00, 0x00, 0x00, 0x00, 0x00, 0x00, 0x00, 0x00, 0x00, 0x00, 0x00, 0x00, 0x00, 0x00, 
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  0xff, 0xff, 0x06, 0x03, 0x07, 0xff, 0xf8, 0x06, 0x03, 0x1f, 0xff, 0xe0, 0xc0, 0x60, 0xff, 0xff
};
Servo myservo;
Servo myservo2;
int servoPin = 18;
int servoPin2 = 19;

int ax, ay;
Adafruit_MPU6050 mpu;

const float CONTROL_KP = 4.0f;
const float CONTROL_KI = 0.02f;
const float CONTROL_KD = 0.8f;
const float FILTER_ALPHA = 0.98f;
const float RAD_TO_DEG_FACTOR = 57.29578f;
const unsigned long SENSOR_TIMEOUT_MS = 250;

float fusedPitch = 0.0f;
float fusedRoll = 0.0f;
float pitchIntegral = 0.0f;
float rollIntegral = 0.0f;
float lastPitchError = 0.0f;
float lastRollError = 0.0f;
unsigned long lastSensorMillis = 0;
bool controlInitialized = false;

// Calibration bias offsets
float accelBiasX = 0.0f;
float accelBiasY = 0.0f;
float gyroBiasX = 0.0f;
float gyroBiasY = 0.0f;
float gyroBiasZ = 0.0f;

// Loop timing variables
unsigned long lastLoopMicros = 0;
const unsigned long CONTROL_PERIOD_MICROS = 10000; // 10ms = 100 Hz

// OLED non-blocking refresh timer
unsigned long lastOledMillis = 0;
const unsigned long OLED_PERIOD_MS = 200; // 5 Hz

float accelX = 0.0f;
float accelY = 0.0f;
float accelZ = 0.0f;
float gyroX = 0.0f;
float gyroY = 0.0f;
float gyroZ = 0.0f;
bool sensorHealthy = false;

bool readSensors();
void computePID(unsigned long nowMillis, float dt);
void writeServos();
void logFlightData(unsigned long nowMillis);
void calibrateMPU();
void updateOLED(unsigned long nowMillis);

void setup(void) {
  Serial.begin(115200);
#if !SIMULATION_MODE
  Wire.setTimeOut(20);
#endif
  display.begin(SSD1306_SWITCHCAPVCC, 0x3C);
  display.clearDisplay();
  display.drawBitmap(0, 0, myBitmap, 128, 64, WHITE);
  display.display();

#if !SIMULATION_MODE
  while (!Serial) {
    delay(10);
  }
#endif

#if !SIMULATION_MODE
  if (!mpu.begin()) {
    Serial.println("Failed to find MPU6050 chip");
    display.clearDisplay();
    display.setTextSize(2);
    display.setTextColor(WHITE);
    display.setCursor(12, 15);
    display.println("NO MPU6050");
    display.setTextSize(1);
    display.setCursor(12, 40);
    display.println("Check connections!");
    display.display();
    while (1) {
      delay(10);
    }
  }
  mpu.setAccelerometerRange(MPU6050_RANGE_16_G);
  mpu.setGyroRange(MPU6050_RANGE_250_DEG);
  mpu.setFilterBandwidth(MPU6050_BAND_21_HZ);
  delay(100);

  // Perform automatic sensor offset calibration
  calibrateMPU();

  ESP32PWM::allocateTimer(0);
  ESP32PWM::allocateTimer(1);
  ESP32PWM::allocateTimer(2);
  ESP32PWM::allocateTimer(3);

  myservo.setPeriodHertz(50);    // standard 50 hz servo
  myservo.attach(servoPin, 1000, 2000);
  myservo2.setPeriodHertz(50);
  myservo2.attach(servoPin2, 1000, 2000);
#else
  Serial.println("timestamp,mode,accelX,accelY,accelZ,gyroX,gyroY,gyroZ,servoX,servoY,healthy");
#endif

  // Initialize loop timer
  lastLoopMicros = micros();
  lastOledMillis = millis();
}

void loop() {
  unsigned long nowMicros = micros();

  // 1. Precise Control Loop (100 Hz = 10,000 microseconds)
  if (nowMicros - lastLoopMicros >= CONTROL_PERIOD_MICROS) {
    unsigned long dtMicros = nowMicros - lastLoopMicros;
    lastLoopMicros = nowMicros;

    unsigned long nowMillis = millis();
    sensorHealthy = readSensors();

    if (!sensorHealthy || (nowMillis - lastSensorMillis) > SENSOR_TIMEOUT_MS) {
      ax = 90;
      ay = 90;
      pitchIntegral = 0.0f;
      rollIntegral = 0.0f;
      lastPitchError = 0.0f;
      lastRollError = 0.0f;
      controlInitialized = false;
      writeServos();
      logFlightData(nowMillis);
    } else {
      // Calculate precise dt in seconds from elapsed microseconds
      float dt = dtMicros * 0.000001f;
      computePID(nowMillis, dt);
      writeServos();
      logFlightData(nowMillis);
    }
  }

  // 2. Non-blocking OLED Telemetry Update (5 Hz = 200ms)
  unsigned long nowMillis = millis();
  if (nowMillis - lastOledMillis >= OLED_PERIOD_MS) {
    lastOledMillis = nowMillis;
    updateOLED(nowMillis);
  }
}

bool readSensors() {
#if SIMULATION_MODE
  unsigned long nowMillis = millis();
  float timeSeconds = nowMillis * 0.001f;
  accelX = sinf(timeSeconds * 1.1f) * 1.5f;
  accelY = cosf(timeSeconds * 0.9f) * 1.2f;
  accelZ = 9.81f + (sinf(timeSeconds * 0.5f) * 0.15f);
  gyroX = sinf(timeSeconds * 1.7f) * 0.8f;
  gyroY = cosf(timeSeconds * 1.3f) * 0.8f;
  gyroZ = sinf(timeSeconds * 0.7f) * 0.2f;
  lastSensorMillis = nowMillis;
  return true;
#else
  sensors_event_t a, g, temp;
  mpu.getEvent(&a, &g, &temp);

  // Apply calibration offsets to raw measurements
  accelX = a.acceleration.x - accelBiasX;
  accelY = a.acceleration.y - accelBiasY;
  accelZ = a.acceleration.z; // Keep raw Z axis
  gyroX = g.gyro.x - gyroBiasX;
  gyroY = g.gyro.y - gyroBiasY;
  gyroZ = g.gyro.z - gyroBiasZ;

  bool readingValid = isfinite(accelX) && isfinite(accelY) && isfinite(accelZ)
    && isfinite(gyroX) && isfinite(gyroY) && isfinite(gyroZ);

  if (readingValid) {
    lastSensorMillis = millis();
  }

  return readingValid;
#endif
}

void computePID(unsigned long nowMillis, float dt) {
  dt = constrain(dt, 0.001f, 0.1f);

  float accelPitch = atan2(accelX, sqrt((accelY * accelY) + (accelZ * accelZ))) * RAD_TO_DEG_FACTOR;
  float accelRoll = atan2(accelY, sqrt((accelX * accelX) + (accelZ * accelZ))) * RAD_TO_DEG_FACTOR;

  if (!controlInitialized) {
    fusedPitch = accelPitch;
    fusedRoll = accelRoll;
    controlInitialized = true;
  } else {
    float gyroPitchRate = gyroX * RAD_TO_DEG_FACTOR;
    float gyroRollRate = gyroY * RAD_TO_DEG_FACTOR;
    fusedPitch = FILTER_ALPHA * (fusedPitch + gyroPitchRate * dt) + (1.0f - FILTER_ALPHA) * accelPitch;
    fusedRoll = FILTER_ALPHA * (fusedRoll + gyroRollRate * dt) + (1.0f - FILTER_ALPHA) * accelRoll;
  }

  float pitchError = 0.0f - fusedPitch;
  float rollError = 0.0f - fusedRoll;
  pitchIntegral = constrain(pitchIntegral + (pitchError * dt), -30.0f, 30.0f);
  rollIntegral = constrain(rollIntegral + (rollError * dt), -30.0f, 30.0f);
  float pitchDerivative = (pitchError - lastPitchError) / dt;
  float rollDerivative = (rollError - lastRollError) / dt;
  lastPitchError = pitchError;
  lastRollError = rollError;

  float pitchCommand = 90.0f + (CONTROL_KP * pitchError) + (CONTROL_KI * pitchIntegral) + (CONTROL_KD * pitchDerivative);
  float rollCommand = 90.0f + (CONTROL_KP * rollError) + (CONTROL_KI * rollIntegral) + (CONTROL_KD * rollDerivative);
  pitchCommand = constrain(pitchCommand, 0.0f, 180.0f);
  rollCommand = constrain(rollCommand, 0.0f, 180.0f);

  ax = (int)pitchCommand;
  ay = (int)rollCommand;
  ax = constrain(ax, 0, 180);
  ay = constrain(ay, 0, 180);
}

void writeServos() {
#if !SIMULATION_MODE
  myservo.write(ax);
  myservo2.write(ay);
#endif
}

void logFlightData(unsigned long nowMillis) {
  Serial.print(nowMillis);
  Serial.print(",");
  Serial.print(SIMULATION_MODE ? 1 : 0);
  Serial.print(",");
  Serial.print(accelX);
  Serial.print(",");
  Serial.print(accelY);
  Serial.print(",");
  Serial.print(accelZ);
  Serial.print(",");
  Serial.print(gyroX);
  Serial.print(",");
  Serial.print(gyroY);
  Serial.print(",");
  Serial.print(gyroZ);
  Serial.print(",");
  Serial.print(ax);
  Serial.print(",");
  Serial.print(ay);
  Serial.print(",");
  Serial.println(sensorHealthy ? 1 : 0);
}

void calibrateMPU() {
#if !SIMULATION_MODE
  display.clearDisplay();
  display.setTextSize(1);
  display.setTextColor(WHITE);
  
  display.setCursor(0, 5);
  display.println("MPU6050 CALIBRATION");
  display.drawFastHLine(0, 15, 128, WHITE);
  
  display.setCursor(0, 22);
  display.println("Place flat & still");
  display.println("Calibrating...");
  display.display();
  
  Serial.println("Starting MPU6050 Calibration... Keep flat and stationary.");

  float sumAccX = 0.0f;
  float sumAccY = 0.0f;
  float sumGyrX = 0.0f;
  float sumGyrY = 0.0f;
  float sumGyrZ = 0.0f;
  
  const int NUM_SAMPLES = 100;
  for (int i = 0; i < NUM_SAMPLES; i++) {
    sensors_event_t a, g, temp;
    mpu.getEvent(&a, &g, &temp);
    
    sumAccX += a.acceleration.x;
    sumAccY += a.acceleration.y;
    sumGyrX += g.gyro.x;
    sumGyrY += g.gyro.y;
    sumGyrZ += g.gyro.z;
    
    // Draw a visual loading bar (100 pixels wide)
    display.fillRect(14, 46, (i + 1), 6, WHITE);
    display.display();
    
    delay(20);
  }
  
  accelBiasX = sumAccX / NUM_SAMPLES;
  accelBiasY = sumAccY / NUM_SAMPLES;
  gyroBiasX = sumGyrX / NUM_SAMPLES;
  gyroBiasY = sumGyrY / NUM_SAMPLES;
  gyroBiasZ = sumGyrZ / NUM_SAMPLES;
  
  Serial.print("MPU Calibration Complete. Offsets: AccX=");
  Serial.print(accelBiasX);
  Serial.print(", AccY=");
  Serial.print(accelBiasY);
  Serial.print(", GyrX=");
  Serial.print(gyroBiasX);
  Serial.print(", GyrY=");
  Serial.print(gyroBiasY);
  Serial.print(", GyrZ=");
  Serial.println(gyroBiasZ);

  display.clearDisplay();
  display.setCursor(0, 10);
  display.println("CALIBRATION COMPLETE!");
  display.println();
  display.print("AccX offset: "); display.println(accelBiasX, 2);
  display.print("AccY offset: "); display.println(accelBiasY, 2);
  display.display();
  delay(1500);
#endif
}

void updateOLED(unsigned long nowMillis) {
  display.clearDisplay();
  display.setTextColor(WHITE);
  
  if (!sensorHealthy) {
    display.setTextSize(2);
    display.setCursor(12, 10);
    display.println("SYS FAIL!");
    display.setTextSize(1);
    display.setCursor(12, 35);
    display.println("Servos centered.");
    display.setCursor(12, 47);
    display.println("Check hardware!");
    display.display();
    return;
  }
  
  display.setTextSize(1);
  // Header Row
  display.setCursor(0, 0);
  display.print("ROCKET V-0 ");
  display.println(SIMULATION_MODE ? "[SIM]" : "[REAL]");
  display.drawFastHLine(0, 9, 128, WHITE);
  
  // Telemetry HUD
  display.setCursor(0, 14);
  display.print("Pitch: ");
  if (fusedPitch >= 0) display.print("+");
  display.print(fusedPitch, 1);
  display.print(" deg");

  display.setCursor(0, 26);
  display.print("Roll : ");
  if (fusedRoll >= 0) display.print("+");
  display.print(fusedRoll, 1);
  display.print(" deg");

  display.setCursor(0, 38);
  display.print("Servo X: ");
  display.print(ax);
  
  display.setCursor(0, 50);
  display.print("Servo Y: ");
  display.print(ay);
  
  display.display();
}