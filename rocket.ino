#include <Adafruit_MPU6050.h>
#include <Adafruit_Sensor.h>
#include <Wire.h>
#include <ESP32Servo.h>
#include <Adafruit_GFX.h>
#include <Adafruit_SSD1306.h>

#if __has_include("sim_config.h")
#include "sim_config.h"
#else
#define SIMULATION_MODE 0
#endif

#define OLED_RESET 4
Adafruit_SSD1306 display(128, 64, &Wire, OLED_RESET);

const unsigned char myBitmap [] PROGMEM = {
  0x00, 0x00, 0x00, 0x00, 0x00, 0x00, 0x00, 0x00, 0x00, 0x00, 0x00, 0x00, 0x00, 0x00, 0x00, 0x00, 
  0x00, 0x00, 0x00, 0x00, 0x00, 0x00, 0x00, 0x00, 0x00, 0x00, 0x00, 0x00, 0x00, 0x00, 0x00, 0x00, 
  0x00, 0x00, 0x00, 0x00, 0x00, 0x00, 0x00, 0x00, 0x00, 0x00, 0x00, 0x00, 0x00, 0x00, 0x00, 0x00, 
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  0xff, 0xff, 0x06, 0x03, 0x07, 0xff, 0xf8, 0x06, 0x03, 0x1f, 0xff, 0xe0, 0xc0, 0x60, 0xff, 0xff
};
Servo myservo;
Servo myservo2;
int servoPin = 18;
int servoPin2 = 19;

int ax, ay;
Adafruit_MPU6050 mpu;

const float CONTROL_KP = 4.0f;
const float CONTROL_KI = 0.02f;
const float CONTROL_KD = 0.8f;
const float FILTER_ALPHA = 0.98f;
const float RAD_TO_DEG_FACTOR = 57.29578f;
const unsigned long SENSOR_TIMEOUT_MS = 250;

float fusedPitch = 0.0f;
float fusedRoll = 0.0f;
float pitchIntegral = 0.0f;
float rollIntegral = 0.0f;
float lastPitchError = 0.0f;
float lastRollError = 0.0f;
unsigned long lastControlMillis = 0;
unsigned long lastSensorMillis = 0;
bool controlInitialized = false;

float accelX = 0.0f;
float accelY = 0.0f;
float accelZ = 0.0f;
float gyroX = 0.0f;
float gyroY = 0.0f;
float gyroZ = 0.0f;
bool sensorHealthy = false;

bool readSensors();
void computePID(unsigned long nowMillis);
void writeServos();
void logFlightData(unsigned long nowMillis);

void setup(void) {
  Serial.begin(115200);
#if !SIMULATION_MODE
  Wire.setTimeOut(20);
#endif
  display.begin(SSD1306_SWITCHCAPVCC, 0x3C);
  display.clearDisplay();
  display.drawBitmap(0, 0, myBitmap, 128, 64, WHITE);
  display.display();

#if !SIMULATION_MODE
  while (!Serial) {
    delay(10);
  }
#endif

#if !SIMULATION_MODE
  if (!mpu.begin()) {
    Serial.println("Failed to find MPU6050 chip");
    while (1) {
      delay(10);
    }
  }
  mpu.setAccelerometerRange(MPU6050_RANGE_16_G);
  mpu.setGyroRange(MPU6050_RANGE_250_DEG);
  mpu.setFilterBandwidth(MPU6050_BAND_21_HZ);
  delay(100);
  ESP32PWM::allocateTimer(0);
  ESP32PWM::allocateTimer(1);
  ESP32PWM::allocateTimer(2);
  ESP32PWM::allocateTimer(3);

  myservo.setPeriodHertz(50);    // standard 50 hz servo
  myservo.attach(servoPin, 1000, 2000);
  myservo2.setPeriodHertz(50);
  myservo2.attach(servoPin2, 1000, 2000);
#else
  Serial.println("timestamp,mode,accelX,accelY,accelZ,gyroX,gyroY,gyroZ,servoX,servoY,healthy");
#endif
}

void loop() {
  unsigned long nowMillis = millis();
  sensorHealthy = readSensors();

  if (!sensorHealthy || (nowMillis - lastSensorMillis) > SENSOR_TIMEOUT_MS) {
    ax = 90;
    ay = 90;
    pitchIntegral = 0.0f;
    rollIntegral = 0.0f;
    lastPitchError = 0.0f;
    lastRollError = 0.0f;
    controlInitialized = false;
    writeServos();
    logFlightData(nowMillis);
    delay(10);
    return;
  }

  computePID(nowMillis);
  writeServos();
  logFlightData(nowMillis);
  delay(10);
}

bool readSensors() {
#if SIMULATION_MODE
  unsigned long nowMillis = millis();
  float timeSeconds = nowMillis * 0.001f;
  accelX = sinf(timeSeconds * 1.1f) * 1.5f;
  accelY = cosf(timeSeconds * 0.9f) * 1.2f;
  accelZ = 9.81f + (sinf(timeSeconds * 0.5f) * 0.15f);
  gyroX = sinf(timeSeconds * 1.7f) * 0.8f;
  gyroY = cosf(timeSeconds * 1.3f) * 0.8f;
  gyroZ = sinf(timeSeconds * 0.7f) * 0.2f;
  lastSensorMillis = nowMillis;
  return true;
#else
  sensors_event_t a, g, temp;
  mpu.getEvent(&a, &g, &temp);

  accelX = a.acceleration.x;
  accelY = a.acceleration.y;
  accelZ = a.acceleration.z;
  gyroX = g.gyro.x;
  gyroY = g.gyro.y;
  gyroZ = g.gyro.z;

  bool readingValid = isfinite(accelX) && isfinite(accelY) && isfinite(accelZ)
    && isfinite(gyroX) && isfinite(gyroY) && isfinite(gyroZ);

  if (readingValid) {
    lastSensorMillis = millis();
  }

  return readingValid;
#endif
}

void computePID(unsigned long nowMillis) {

  float dt = 0.01f;
  if (lastControlMillis != 0) {
    dt = (nowMillis - lastControlMillis) * 0.001f;
  }
  lastControlMillis = nowMillis;
  dt = constrain(dt, 0.001f, 0.1f);

  float accelPitch = atan2(accelX, sqrt((accelY * accelY) + (accelZ * accelZ))) * RAD_TO_DEG_FACTOR;
  float accelRoll = atan2(accelY, sqrt((accelX * accelX) + (accelZ * accelZ))) * RAD_TO_DEG_FACTOR;

  if (!controlInitialized) {
    fusedPitch = accelPitch;
    fusedRoll = accelRoll;
    controlInitialized = true;
  } else {
    float gyroPitchRate = gyroX * RAD_TO_DEG_FACTOR;
    float gyroRollRate = gyroY * RAD_TO_DEG_FACTOR;
    fusedPitch = FILTER_ALPHA * (fusedPitch + gyroPitchRate * dt) + (1.0f - FILTER_ALPHA) * accelPitch;
    fusedRoll = FILTER_ALPHA * (fusedRoll + gyroRollRate * dt) + (1.0f - FILTER_ALPHA) * accelRoll;
  }

  float pitchError = 0.0f - fusedPitch;
  float rollError = 0.0f - fusedRoll;
  pitchIntegral = constrain(pitchIntegral + (pitchError * dt), -30.0f, 30.0f);
  rollIntegral = constrain(rollIntegral + (rollError * dt), -30.0f, 30.0f);
  float pitchDerivative = (pitchError - lastPitchError) / dt;
  float rollDerivative = (rollError - lastRollError) / dt;
  lastPitchError = pitchError;
  lastRollError = rollError;

  float pitchCommand = 90.0f + (CONTROL_KP * pitchError) + (CONTROL_KI * pitchIntegral) + (CONTROL_KD * pitchDerivative);
  float rollCommand = 90.0f + (CONTROL_KP * rollError) + (CONTROL_KI * rollIntegral) + (CONTROL_KD * rollDerivative);
  pitchCommand = constrain(pitchCommand, 0.0f, 180.0f);
  rollCommand = constrain(rollCommand, 0.0f, 180.0f);

  ax = (int)pitchCommand;
  ay = (int)rollCommand;
  ax = constrain(ax, 0, 180);
  ay = constrain(ay, 0, 180);
}

void writeServos() {
#if !SIMULATION_MODE
  myservo.write(ax);
  myservo2.write(ay);
#endif
}

void logFlightData(unsigned long nowMillis) {
  Serial.print(nowMillis);
  Serial.print(",");
  Serial.print(SIMULATION_MODE ? 1 : 0);
  Serial.print(",");
  Serial.print(accelX);
  Serial.print(",");
  Serial.print(accelY);
  Serial.print(",");
  Serial.print(accelZ);
  Serial.print(",");
  Serial.print(gyroX);
  Serial.print(",");
  Serial.print(gyroY);
  Serial.print(",");
  Serial.print(gyroZ);
  Serial.print(",");
  Serial.print(ax);
  Serial.print(",");
  Serial.print(ay);
  Serial.print(",");
  Serial.println(sensorHealthy ? 1 : 0);
}